## examples/basic_scene/main/Kconfig.projbuild
```kconfig
menu "ESP32 3D Engine - Graphics Library Options"
    config GRAPHICS_PARALLEL_ENABLED
        bool "Enable Parallel Graphics"
        default n
        help
            Enable the parallel graphics library for ESP32. This allows for faster rendering
            on displays that support parallel communication.
    
    config GRAPHICS_PAINTER_ALGO_ENABLED
        bool "Enable Painter Algorithm"
        default n
        help
            Enable the painter algorithm for rendering graphics. This is useful for drawing
            shapes and images on the display.

    config GRAPHICS_OPTIMIZATION_ENABLED
        bool "Enable Graphics Optimization"
        default n
        help
            Enable various optimizations for the graphics library to improve performance.
            This may include caching, reduced memory usage, and faster rendering techniques.

    config GRAPHICS_FRUSTUM_CULLING
        bool "Enable Frustum Culling (bounding sphere per mesh)"
        default y
        help
            Skip entire meshes whose bounding sphere lies fully outside the
            camera view frustum. Reduces per-face work significantly when
            many meshes are off-screen.

    config GRAPHICS_SMALL_OBJECT_CULLING
        bool "Enable Small Object Culling (LOD-lite)"
        default y
        help
            Skip meshes whose projected bounding sphere covers less than a
            handful of pixels on screen. Cheap LOD-style optimization for
            distant geometry. Threshold is `GRAPHICS_SMALL_OBJECT_PIXELS`.

    config GRAPHICS_SMALL_OBJECT_PIXELS
        int "Minimum projected radius (pixels) to render a mesh"
        depends on GRAPHICS_SMALL_OBJECT_CULLING
        default 2
        range 1 64
        help
            Meshes whose projected bounding sphere radius is below this many
            pixels are not rendered.

    menu "Debug Overlay (target only)"
        config GRAPHICS_DEBUG_OVERLAY
            bool "Enable on-screen debug overlay"
            default n
            help
                Enables a HUD with FPS, frame time and engine stats drawn directly on
                the framebuffer. Only active on the ESP32-P4 target build.

        config GRAPHICS_DEBUG_SHOW_FPS
            bool "Show FPS / frame time"
            depends on GRAPHICS_DEBUG_OVERLAY
            default y

        config GRAPHICS_DEBUG_SHOW_STATS
            bool "Show triangle / face stats (drawn / clipped / culled)"
            depends on GRAPHICS_DEBUG_OVERLAY
            default y

        config GRAPHICS_DEBUG_SHOW_MEMORY
            bool "Show free heap / PSRAM"
            depends on GRAPHICS_DEBUG_OVERLAY
            default y

        config GRAPHICS_DEBUG_WIREFRAME
            bool "Render in wireframe mode (Bresenham edges)"
            default n
            help
                Replaces polygon fill with edge drawing. Useful for debugging
                geometry, culling and clipping.

        config GRAPHICS_DEBUG_SHOW_NORMALS
            bool "Draw per-face normals as yellow lines"
            default n
            help
                Draws each visible face's normal as a short line from the face
                centroid. Useful for spotting inverted windings.
    endmenu

endmenu
```
